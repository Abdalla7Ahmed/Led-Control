## meta-project/conf/distro/my-distro.conf
```bitbake
require conf/distro/poky.conf



#MAINTAINER = "Abdallah Abotaleb <abdallahahmed17120@gmail.com>"
DISTRO = "my-distro"
DISTRO_NAME = "my-distro (Yocto Project Reference Distro)"
DISTRO_VERSION = "1.0.0"
DISTRO_CODENAME = "dunfell"

#to remove some features from any image based on this distro
#DISTRO_FEATURES:remove = " ext2 pci irda pcmcia ptest 3g nfc"

#using systemd 
INIT_MANAGER = "systemd"
```

## meta-project/conf/machine/my-machine.conf
```bitbake
MACHINEOVERRIDES =. "raspberrypi3:${MACHINE}"

require conf/machine/raspberrypi3.conf
#UART
ENABLE_UART = "1"
#I2C
ENABLE_I2C = "1"
KERNEL_MODULE_AUTOLOAD += "i2c-dev"

#SPI
ENABLE_SPI_BUS = "1"
#SPLASH
DISABLE_SPLASH = "1"
#LOGO
DISABLE_RPI_BOOT_LOGO = "1"
#U-boot
RPI_USE_U_BOOT = "1"


MACHINE_EXTRA_RRECOMMENDS += "kernel-module-my_module"
KERNEL_MODULE_AUTOLOAD += "my_module"
```
